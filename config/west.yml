## config/west.yml
```yaml
manifest:
  remotes:
    - name: zmkfirmware
      url-base: https://github.com/zmkfirmware
    - name: hiyashi-yu
      url-base: https://github.com/hiyashi-yu
  projects:
    - name: zmk
      remote: zmkfirmware
      revision: v0.3.0
      import: app/west.yml
    - name: zmk-naginata
      remote: hiyashi-yu
      revision: main
  self:
    path: config
```
